## main/Kconfig.projbuild
```kconfig
menu "Environment Monitor Configuration"

    config WIFI_SSID
        string "Wi-Fi SSID"
        default ""

    config WIFI_PASSWORD
        string "Wi-Fi Password"
        default ""

    config MQTT_BROKER_URI
        string "MQTT Broker URI"
        default "mqtt://broker.hivemq.com"

endmenu
```
